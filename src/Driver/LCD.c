#include"LCD.h"
const uint16_t clear[]={
    0xFFFF,0xFFFF,0xFFFF,0xFFFF,0xFFFF,0xFFFF,0xFFFF,0xFFFF,0xFFFF,0xFFFF,0xFFFF,0xFFFF,
    0xFFFF,0xFFFF,0xFFFF,0xFFFF,0xFFFF,0xFFFF,0xFFFF,0xFFFF,0xFFFF,0xFFFF,0xFFFF,0xFFFF,
    0xFFFF,0xFFFF,0xFFFF,0xFFFF,0xFFFF,0xFFFF,0xFFFF,0xFFFF,0xFFFF,0xFFFF,0xFFFF,0xFFFF,
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    0xFFFF,0xFFFF,0xFFFF,0xFFFF,0xFFFF,0xFFFF,0xFFFF,0xFFFF,0xFFFF,0xFFFF,0xFFFF,0xFFFF, 
};

void LCD_init(void)
{
    PTFIFO = 0xffffffff;
}

void LCD_clear(void)
{
    uint32_t xy,temp_size;
    for(int x=0;x<240;x+=12)
    {
        for(int y=0;y<320;y+=12)
        {
            xy = ((uint32_t)x << 16) | (uint32_t)y;
            temp_size = (uint32_t)(12 - 1);
            PTFIFO = xy;
            PTFIFO = temp_size;
            PTFIFO = (uint32_t)clear; 
        }
    }
    
}
void Draw_pic(const uint16_t* pic,uint16_t x,uint16_t y,uint16_t size)
{
    if((x+size <= X_Limit)&&(y+size <= Y_Limit))
    {
       uint32_t xy,temp_size;
        xy = ((uint32_t)x << 16) | (uint32_t)y;
        temp_size = (uint32_t)(size - 1);

        PTFIFO = xy;
        PTFIFO = temp_size;
        PTFIFO = (uint32_t)pic; 
    }
}
